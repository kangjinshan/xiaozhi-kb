## sdkconfig.defaults.esp32c6
```kconfig
CONFIG_ESPTOOLPY_FLASHSIZE_16MB=y
CONFIG_PARTITION_TABLE_CUSTOM_FILENAME="partitions/v2/16m_c3.csv"
CONFIG_ESPTOOLPY_FLASHMODE_QIO=y

CONFIG_SR_WN_WN9S_NIHAOXIAOZHI=y

# --- 目标板型固化：Waveshare ESP32-C6 Touch AMOLED 2.16 ---
# 必须显式指定，否则干净构建会回退到默认板型（曾误选 2.06），
# 导致三键 GPIO 宏(config.h)不匹配、烧录到错误板型。
CONFIG_BOARD_TYPE_WAVESHARE_ESP32_C6_TOUCH_AMOLED_2_16=y

# --- NimBLE HID：非阻塞通知，适合 50 Hz 键鼠复合报告 ---
CONFIG_BT_ENABLED=y
CONFIG_BT_NIMBLE_ENABLED=y
CONFIG_BT_NIMBLE_HID_SERVICE=y
CONFIG_BT_NIMBLE_SVC_GAP_DEVICE_NAME="XiaoZhi KB"
CONFIG_BT_NIMBLE_LOG_LEVEL_WARNING=y
CONFIG_BT_NIMBLE_SM_LVL=2
CONFIG_BT_NIMBLE_NVS_PERSIST=y


# --- 调试期：主console走USB-Serial/JTAG，确保USB CDC能读到全部日志 ---
CONFIG_ESP_CONSOLE_USB_SERIAL_JTAG=y

# --- 调试期：bootloader 也打印启动分区选择 ---
# CONFIG_BOOTLOADER_LOG_LEVEL_NONE is not set
CONFIG_BOOTLOADER_LOG_LEVEL_INFO=y
```
